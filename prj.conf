## CMakeLists.txt
```
# SPDX-License-Identifier: Apache-2.0

cmake_minimum_required(VERSION 3.20.0)
find_package(Zephyr REQUIRED HINTS $ENV{ZEPHYR_BASE})
project(USB_BLE_HID)

FILE(GLOB app_sources src/*.c)
target_sources(app PRIVATE
  ${app_sources}
  )
```

## sample.yaml
```
sample:
  name: USB Bluetooth Peripheral HIDs
  description: Bluetooth Low Energy HID-over-GATT service through console
tests:
  sample.bluetooth.peripheral_hids:
    harness: bluetooth
    platform_allow: nrf52840dongle_nrf52840
    tags: bluetooth
    integration_platforms:
      - nrf52840dongle_nrf52840
  sample.bluetooth.peripheral_hids.no_authentication:
    harness: bluetooth
    extra_configs:
      - CONFIG_SAMPLE_BT_USE_AUTHENTICATION=n
    platform_allow: nrf52840dongle_nrf52840
    tags: bluetooth
    integration_platforms:
      - nrf52840dongle_nrf52840

  sample.usb.console:
    depends_on:
      - usb_device
      - usb_cdc
    tags: usb
    platform_exclude:
      - native_posix
      - native_posix_64
    harness: console
    harness_config:
      fixture: fixture_usb_cdc
```

## west.yml
```
manifest:
  remotes:
    - name: nrfconnect
      url-base: https://github.com/nrfconnect
  projects:
    - name: nrf
      repo-path: sdk-nrf
      remote: nrfconnect
      revision: v1.7.1
```

## prj.conf
```kconfig
# Increased stack due to settings API usage
CONFIG_SYSTEM_WORKQUEUE_STACK_SIZE=2048

CONFIG_BT=y
CONFIG_LOG=y
CONFIG_BT_SMP=y
CONFIG_BT_PERIPHERAL=y
CONFIG_BT_DIS=y
CONFIG_BT_BAS=y
CONFIG_BT_DEVICE_NAME="MZ-VM-BLE01-0001"
CONFIG_BT_DEVICE_APPEARANCE=962
CONFIG_SAMPLE_BT_USE_AUTHENTICATION=n

CONFIG_BT_SETTINGS=y
CONFIG_FLASH=y
CONFIG_FLASH_PAGE_LAYOUT=y
CONFIG_FLASH_MAP=y
CONFIG_NVS=y
CONFIG_SETTINGS=y

CONFIG_USB_DEVICE_STACK=y
CONFIG_USB_DEVICE_PRODUCT="MZ-VM-USB01-0001"
CONFIG_USB_DEVICE_PID=0x0004
CONFIG_USB_DEVICE_INITIALIZE_AT_BOOT=n 

CONFIG_SERIAL=y
CONFIG_CONSOLE=y
CONFIG_UART_CONSOLE=y
CONFIG_UART_LINE_CTRL=y
```

## src/main.c
```c
/**
 * @file main.c
 * @brief Application main entry point
 *
 * This file contains the main entry point for the application.
 */
/**< Author: Dhruv Menon */
/*
 * Copyright (c) 2016 Intel Corporation
 *
 * SPDX-License-Identifier: Apache-2.0
 */

#include <zephyr/types.h>		  /**< Include Zephyr types */
#include <stddef.h>				  /**< Include standard definitions */
#include <string.h>				  /**< Include string manipulation functions */
#include <errno.h>				  /**< Include error handling */
#include <zephyr/sys/printk.h>	  /**< Include printk for printing */
#include <zephyr/sys/byteorder.h> /**< Include byte order conversion */
#include <zephyr/kernel.h>		  /**< Include kernel related functionalities */

#include <zephyr/settings/settings.h> /**< Include Zephyr settings */

#include <zephyr/bluetooth/bluetooth.h> /**< Include Bluetooth stack */
#include <zephyr/bluetooth/hci.h>		/**< Include Bluetooth HCI */
#include <zephyr/bluetooth/conn.h>		/**< Include Bluetooth connection */
#include <zephyr/bluetooth/uuid.h>		/**< Include Bluetooth UUID */
#include <zephyr/bluetooth/gatt.h>		/**< Include Bluetooth GATT */

#include "hog.h" /**< Include Human Interface Device (HID) over GATT */

#include <zephyr/usb/usb_device.h> /**< Include USB device stack */
#include <zephyr/usb/usbd.h>	   /**< Include USB device functions */
#include <zephyr/drivers/uart.h>   /**< Include UART driver */
#include <stdio.h>				   /**< Include standard I/O */
#include <string.h>				   /**< Include string manipulation functions */
#include <stdlib.h>				   /**< Include standard library */
#include <ctype.h>
#include <zephyr/drivers/gpio.h>

#define LED1_NODE DT_ALIAS(led1)
#define LED2_NODE DT_ALIAS(led2)
#define LED3_NODE DT_ALIAS(led3)
static const struct gpio_dt_spec led1 = GPIO_DT_SPEC_GET(LED1_NODE, gpios);
static const struct gpio_dt_spec led2 = GPIO_DT_SPEC_GET(LED2_NODE, gpios);
static const struct gpio_dt_spec led3 = GPIO_DT_SPEC_GET(LED3_NODE, gpios);
int ret;

#define STACKSIZE 1024 /**< Define stack size */

#define MAX_DATA_LEN 50 /**< Define maximum data length */

static char report[3][MAX_DATA_LEN]; /**< Define report data array */
uint8_t global_report[8];			 /**< Define global report array for keyboard */
struct bt_conn *default_conn = NULL;
#if defined(CONFIG_USB_DEVICE_STACK_NEXT)
USBD_CONFIGURATION_DEFINE(config_1,
						  USB_SCD_SELF_POWERED,
						  200);

USBD_DESC_LANG_DEFINE(sample_lang);									 /**< Define USB language descriptor */
USBD_DESC_MANUFACTURER_DEFINE(sample_mfr, "ZEPHYR");				 /**< Define USB manufacturer descriptor */
USBD_DESC_PRODUCT_DEFINE(sample_product, "Zephyr USBD ACM console"); /**< Define USB product descriptor */
USBD_DESC_SERIAL_NUMBER_DEFINE(sample_sn, "0123456789ABCDEF");		 /**< Define USB serial number descriptor */

USBD_DEVICE_DEFINE(sample_usbd,
				   DEVICE_DT_GET(DT_NODELABEL(zephyr_udc0)),
				   0x2fe3, 0x0001); /**< Define USB device */

static int enable_usb_device_next(void)
{
	int err;

	err = usbd_add_descriptor(&sample_usbd, &sample_lang); /**< Add language descriptor */
	if (err)
	{
		return err;
	}

	err = usbd_add_descriptor(&sample_usbd, &sample_mfr); /**< Add manufacturer descriptor */
	if (err)
	{
		return err;
	}

	err = usbd_add_descriptor(&sample_usbd, &sample_product); /**< Add product descriptor */
	if (err)
	{
		return err;
	}

	err = usbd_add_descriptor(&sample_usbd, &sample_sn); /**< Add serial number descriptor */
	if (err)
	{
		return err;
	}

	err = usbd_add_configuration(&sample_usbd, &config_1); /**< Add USB configuration */
	if (err)
	{
		return err;
	}

	err = usbd_register_class(&sample_usbd, "cdc_acm_0", 1); /**< Register USB class */
	if (err)
	{
		return err;
	}

	err = usbd_init(&sample_usbd); /**< Initialize USB device */
	if (err)
	{
		return err;
	}

	err = usbd_enable(&sample_usbd); /**< Enable USB device */
	if (err)
	{
		return err;
	}

	return 0;
}
#endif /* IS_ENABLED(CONFIG_USB_DEVICE_STACK_NEXT) */

/**
 * @brief Process the received data
 *
 * This function processes the received data.
 *
 * @param[in] data Data to be processed
 */
static void process_data(const char *data)
{
	char *data_copy = strdup(data); /**< Create a copy to modify */
	size_t len = strlen(data);
	while (len > 0 && isspace((unsigned char)data[len - 1]))
	{
		len--;
	}
	data_copy[len] = '\0'; // Trimmed string

	printk("Received data: %s\n", data);

	if (strcmp(data_copy, "getDeviceId") == 0)
	{
		// Print the Bluetooth device name
		printk("Bluetooth Device Name: %s\n", CONFIG_BT_DEVICE_NAME);
		return;
	}
	else if (strcmp(data_copy, "getConnectedAddress") == 0)
	{
		// Print the connected device address if a connection exists
		if (default_conn)
		{
			char addr[BT_ADDR_LE_STR_LEN];
			bt_addr_le_to_str(bt_conn_get_dst(default_conn), addr, sizeof(addr));
			printk("Connected Device Address: %s\n", addr);
		}
		else
		{
			printk("No device connected\n");
		}
		return;
	}

	if (data_copy == NULL)
	{
		printk("Failed to allocate memory for data copy\n");
		return;
	}

	char *token;
	uint8_t *ptr = global_report;
	int i = 0;

	/* Split the data by space and store in global_report array */
	token = strtok(data_copy, " ");
	while (token != NULL && i < 8)
	{
		/* Convert token to uint8_t and store in global_report */
		*ptr = (uint8_t)strtoul(token, NULL, 10);
		ptr++;
		token = strtok(NULL, " ");
		strcpy(report[i], token);
		report[i][0] = '\0';
		i++;
	}

	while (i < 8)
	{
		report[i][0] = '\0';
		i++;
	}
	free(data_copy); /**< Free the allocated memory */
}

static const struct bt_data ad[] = {
	BT_DATA_BYTES(BT_DATA_FLAGS, (BT_LE_AD_GENERAL | BT_LE_AD_NO_BREDR)),
	BT_DATA_BYTES(BT_DATA_UUID16_ALL,
				  BT_UUID_16_ENCODE(BT_UUID_HIDS_VAL),
				  BT_UUID_16_ENCODE(BT_UUID_BAS_VAL)),
};

// Function to control RGB LED
void set_rgb_led_state(uint8_t r, uint8_t g, uint8_t b)
{

	if (ret < 0)
	{
		printk("Error: Failed to initialize LED GPIO port\n");
		return;
	}
	if (r == 1)
	{
		ret = gpio_pin_configure_dt(&led1, GPIO_OUTPUT_ACTIVE);
	}
	else
	{
		ret = gpio_pin_configure_dt(&led1, GPIO_OUTPUT_INACTIVE);
	}
	if (g == 1)
	{
		ret = gpio_pin_configure_dt(&led2, GPIO_OUTPUT_ACTIVE);
	}
	else
	{
		ret = gpio_pin_configure_dt(&led2, GPIO_OUTPUT_INACTIVE);
	}
	if (b == 1)
	{
		ret = gpio_pin_configure_dt(&led3, GPIO_OUTPUT_ACTIVE);
	}
	else
	{
		ret = gpio_pin_configure_dt(&led3, GPIO_OUTPUT_INACTIVE);
	}
	// Set LED pins to desired state
}

/**
 * @brief Callback for connection establishment
 *
 * This function is called when a connection is established.
 *
 * @param[in] conn Connection object
 * @param[in] err Error code
 */
static void connected(struct bt_conn *conn, uint8_t err)
{
	char addr[BT_ADDR_LE_STR_LEN];

	bt_addr_le_to_str(bt_conn_get_dst(conn), addr, sizeof(addr));

	if (err)
	{
		printk("Failed to connect to %s (%u)\n", addr, err);
		return;
	}
	default_conn = conn;

	printk("Connected %s\n", addr);
	set_rgb_led_state(0, 1, 0);

	if (bt_conn_set_security(conn, BT_SECURITY_L2))
	{
		printk("Failed to set security\n");
	}
}

/**
 * @brief Callback for disconnection
 *
 * This function is called when a connection is disconnected.
 *
 * @param[in] conn Connection object
 * @param[in] reason Disconnection reason code
 */
static void disconnected(struct bt_conn *conn, uint8_t reason)
{
	char addr[BT_ADDR_LE_STR_LEN];

	bt_addr_le_to_str(bt_conn_get_dst(conn), addr, sizeof(addr));

	printk("Disconnected from %s (reason 0x%02x)\n", addr, reason);
	set_rgb_led_state(1, 0, 0);
	if (conn == default_conn) // Clear the stored connection object if it matches the disconnected one
	{
		default_conn = NULL;
	}
}

/**
 * @brief Callback for security change
 *
 * This function is called when security level changes.
 *
 * @param[in] conn Connection object
 * @param[in] level Security level
 * @param[in] err Error code
 */
static void security_changed(struct bt_conn *conn, bt_security_t level,
							 enum bt_security_err err)
{
	char addr[BT_ADDR_LE_STR_LEN];

	bt_addr_le_to_str(bt_conn_get_dst(conn), addr, sizeof(addr));

	if (!err)
	{
		printk("Security changed: %s level %u\n", addr, level);
	}
	else
	{
		printk("Security failed: %s level %u err %d\n", addr, level,
			   err);
	}
}

/**
 * @brief Bluetooth initialization callback
 *
 * This function is called when Bluetooth initialization is completed.
 *
 * @param[in] err Error code
 */
BT_CONN_CB_DEFINE(conn_callbacks) = {
	.connected = connected,
	.disconnected = disconnected,
	.security_changed = security_changed,
};

/**
 * @brief Bluetooth ready callback
 *
 * This function is called when Bluetooth is ready.
 *
 * @param[in] err Error code
 */
static void bt_ready(int err)
{
	if (err)
	{
		printk("Bluetooth init failed (err %d)\n", err);
		return;
	}

	printk("Bluetooth initialized\n");

	hog_init();

	if (IS_ENABLED(CONFIG_SETTINGS))
	{
		settings_load();
	}

	err = bt_le_adv_start(BT_LE_ADV_CONN_NAME, ad, ARRAY_SIZE(ad), NULL, 0);
	if (err)
	{
		printk("Advertising failed to start (err %d)\n", err);
		return;
	}

	printk("Advertising successfully started\n");
}

/**
 * @brief Display passkey callback
 *
 * This function is called to display passkey for pairing.
 *
 * @param[in] conn Connection object
 * @param[in] passkey Passkey to be displayed
 */
static void auth_passkey_display(struct bt_conn *conn, unsigned int passkey)
{
	char addr[BT_ADDR_LE_STR_LEN];

	bt_addr_le_to_str(bt_conn_get_dst(conn), addr, sizeof(addr));

	printk("Passkey for %s: %06u\n", addr, passkey);
}

/**
 * @brief Authentication cancel callback
 *
 * This function is called when pairing is cancelled.
 *
 * @param[in] conn Connection object
 */
static void auth_cancel(struct bt_conn *conn)
{
	char addr[BT_ADDR_LE_STR_LEN];

	bt_addr_le_to_str(bt_conn_get_dst(conn), addr, sizeof(addr));

	printk("Pairing cancelled: %s\n", addr);
}

static struct bt_conn_auth_cb auth_cb_display = {
	.passkey_display = auth_passkey_display,
	.passkey_entry = NULL,
	.cancel = auth_cancel,
};

/**
 * @brief Main function
 *
 * The main entry point of the application.
 *
 * @return Returns 0 on successful execution
 */
int main(void)
{
	const struct device *const dev = DEVICE_DT_GET(DT_CHOSEN(zephyr_console));
	uint32_t dtr = 0;

#if defined(CONFIG_USB_DEVICE_STACK_NEXT)
	if (enable_usb_device_next())
	{
		return 0;
	}
#else
	if (usb_enable(NULL))
	{
		return 0;
	}
#endif

	/* Poll if the DTR flag was set */
	while (!dtr)
	{
		uart_line_ctrl_get(dev, UART_LINE_CTRL_DTR, &dtr);
		/* Give CPU resources to low priority threads. */
		k_sleep(K_MSEC(10));
	}

	int err;

	err = bt_enable(bt_ready);
	if (err)
	{
		printk("Bluetooth init failed (err %d)\n", err);
		return 0;
	}

	if (IS_ENABLED(CONFIG_SAMPLE_BT_USE_AUTHENTICATION))
	{
		bt_conn_auth_cb_register(&auth_cb_display);
		printk("Bluetooth authentication callbacks registered.\n");
	}

	char data[MAX_DATA_LEN];
	while (1)
	{
		/* Check if any data is available from USB */
		ssize_t bytes_read = uart_fifo_read(dev, data, sizeof(data));
		if (bytes_read > 0)
		{
			printk("%d\n", bytes_read);
			data[bytes_read] = '\0'; /**< Null-terminate the string */
			process_data(data);		 /**< Process the received data */
		}

		/* Print the report array contents */
		printk("Report: %d, %d, %d, %d, %d, %d, %d, %d\n",
			   global_report[0], global_report[1], global_report[2], global_report[3],
			   global_report[4], global_report[5], global_report[6], global_report[7]);

		// Reset global_report

		hog_button_loop(global_report);
		memset(global_report + 2, 0, 6); // Reset keypresses
		k_sleep(K_MSEC(100));
	}

	return 0;
}
```

## src/hog.c
```c
/** @file
 *  @brief HoG Service sample for Keyboard
 */

/*
 * Copyright (c) 2016 Intel Corporation
 *
 * SPDX-License-Identifier: Apache-2.0
 */

#include <zephyr/types.h>
#include <stddef.h>
#include <string.h>
#include <errno.h>
#include <zephyr/sys/printk.h>
#include <zephyr/sys/byteorder.h>
#include <zephyr/kernel.h>

#include <zephyr/bluetooth/bluetooth.h>
#include <zephyr/bluetooth/hci.h>
#include <zephyr/bluetooth/conn.h>
#include <zephyr/bluetooth/uuid.h>
#include <zephyr/bluetooth/gatt.h>

enum
{
	HIDS_REMOTE_WAKE = BIT(0),
	HIDS_NORMALLY_CONNECTABLE = BIT(1),
};

struct hids_info
{
	uint16_t version;
	uint8_t code;
	uint8_t flags;
} __packed;

struct hids_report
{
	uint8_t id;
	uint8_t type;
} __packed;

static struct hids_info info = {
	.version = 0x0000,
	.code = 0x00,
	.flags = HIDS_NORMALLY_CONNECTABLE,
};

enum
{
	HIDS_INPUT = 0x01,
	HIDS_OUTPUT = 0x02,
	HIDS_FEATURE = 0x03,
};

static struct hids_report input = {
	.id = 0x01,
	.type = HIDS_INPUT,
};

static uint8_t simulate_input;
static uint8_t ctrl_point;
static uint8_t report_map[] = {
	0x05, 0x01, /* Usage Page (Generic Desktop) */
	0x09, 0x06, /* Usage (Keyboard) */
	0xA1, 0x01, /* Collection (Application) */
	0x85, 0x01, /* Report ID (1) */
	0x05, 0x07, /* Usage Page (Key Codes) */
	0x19, 0xE0, /* Usage Minimum (224) */
	0x29, 0xE7, /* Usage Maximum (231) */
	0x15, 0x00, /* Logical Minimum (0) */
	0x25, 0x01, /* Logical Maximum (1) */
	0x75, 0x01, /* Report Size (1) */
	0x95, 0x08, /* Report Count (8) */
	0x81, 0x02, /* Input (Data, Variable, Absolute) */
	0x95, 0x01, /* Report Count (1) */
	0x75, 0x08, /* Report Size (8) */
	0x81, 0x03, /* Input (Constant, Variable, Absolute) */
	0x95, 0x05, /* Report Count (5) */
	0x75, 0x01, /* Report Size (1) */
	0x05, 0x08, /* Usage Page (LEDs) */
	0x19, 0x01, /* Usage Minimum (1) */
	0x29, 0x05, /* Usage Maximum (5) */
	0x91, 0x02, /* Output (Data, Variable, Absolute) */
	0x95, 0x01, /* Report Count (1) */
	0x75, 0x03, /* Report Size (3) */
	0x91, 0x03, /* Output (Constant, Variable, Absolute) */
	0x95, 0x06, /* Report Count (6) */
	0x75, 0x08, /* Report Size (8) */
	0x15, 0x00, /* Logical Minimum (0) */
	0x25, 0x65, /* Logical Maximum (101) */
	0x05, 0x07, /* Usage Page (Key Codes) */
	0x19, 0x00, /* Usage Minimum (0) */
	0x29, 0x65, /* Usage Maximum (101) */
	0x81, 0x00, /* Input (Data, Array) */
	0xC0		/* End Collection */
};

static ssize_t read_info(struct bt_conn *conn,
						 const struct bt_gatt_attr *attr, void *buf,
						 uint16_t len, uint16_t offset)
{
	return bt_gatt_attr_read(conn, attr, buf, len, offset, attr->user_data,
							 sizeof(struct hids_info));
}

static ssize_t read_report_map(struct bt_conn *conn,
							   const struct bt_gatt_attr *attr, void *buf,
							   uint16_t len, uint16_t offset)
{
	return bt_gatt_attr_read(conn, attr, buf, len, offset, report_map,
							 sizeof(report_map));
}

static ssize_t read_report(struct bt_conn *conn,
						   const struct bt_gatt_attr *attr, void *buf,
						   uint16_t len, uint16_t offset)
{
	return bt_gatt_attr_read(conn, attr, buf, len, offset, attr->user_data,
							 sizeof(struct hids_report));
}

static void input_ccc_changed(const struct bt_gatt_attr *attr, uint16_t value)
{
	simulate_input = (value == BT_GATT_CCC_NOTIFY) ? 1 : 0;
}

static ssize_t read_input_report(struct bt_conn *conn,
								 const struct bt_gatt_attr *attr, void *buf,
								 uint16_t len, uint16_t offset)
{
	return bt_gatt_attr_read(conn, attr, buf, len, offset, NULL, 0);
}

static ssize_t write_ctrl_point(struct bt_conn *conn,
								const struct bt_gatt_attr *attr,
								const void *buf, uint16_t len, uint16_t offset,
								uint8_t flags)
{
	uint8_t *value = attr->user_data;

	if (offset + len > sizeof(ctrl_point))
	{
		return BT_GATT_ERR(BT_ATT_ERR_INVALID_OFFSET);
	}

	memcpy(value + offset, buf, len);

	return len;
}

#if CONFIG_SAMPLE_BT_USE_AUTHENTICATION
#define SAMPLE_BT_PERM_READ BT_GATT_PERM_READ_AUTHEN
#define SAMPLE_BT_PERM_WRITE BT_GATT_PERM_WRITE_AUTHEN
#else
#define SAMPLE_BT_PERM_READ BT_GATT_PERM_READ_ENCRYPT
#define SAMPLE_BT_PERM_WRITE BT_GATT_PERM_WRITE_ENCRYPT
#endif

BT_GATT_SERVICE_DEFINE(hog_svc,
					   BT_GATT_PRIMARY_SERVICE(BT_UUID_HIDS),
					   BT_GATT_CHARACTERISTIC(BT_UUID_HIDS_INFO, BT_GATT_CHRC_READ,
											  BT_GATT_PERM_READ, read_info, NULL, &info),
					   BT_GATT_CHARACTERISTIC(BT_UUID_HIDS_REPORT_MAP, BT_GATT_CHRC_READ,
											  BT_GATT_PERM_READ, read_report_map, NULL, NULL),
					   BT_GATT_CHARACTERISTIC(BT_UUID_HIDS_REPORT,
											  BT_GATT_CHRC_READ | BT_GATT_CHRC_NOTIFY,
											  SAMPLE_BT_PERM_READ,
											  read_input_report, NULL, NULL),
					   BT_GATT_CCC(input_ccc_changed,
								   SAMPLE_BT_PERM_READ | SAMPLE_BT_PERM_WRITE),
					   BT_GATT_DESCRIPTOR(BT_UUID_HIDS_REPORT_REF, BT_GATT_PERM_READ,
										  read_report, NULL, &input),
					   BT_GATT_CHARACTERISTIC(BT_UUID_HIDS_CTRL_POINT,
											  BT_GATT_CHRC_WRITE_WITHOUT_RESP,
											  BT_GATT_PERM_WRITE,
											  NULL, write_ctrl_point, &ctrl_point), );

void hog_init(void)
{
}

void hog_button_loop(int8_t global_report[8])
{
	int8_t report[8] = {0, 0, 0, 0, 0, 0, 0, 0};

	for (int i = 0; i < 8; i++)
	{
		memcpy(&report[i], &global_report[i], sizeof(int8_t));
	}

	bt_gatt_notify(NULL, &hog_svc.attrs[5],
				   report, sizeof(report));
	printk("advertised: %d %d %d %d %d %d %d %d\n", report[0], report[1], report[2], report[3], report[4], report[5], report[6], report[7]);
}
```

## src/hog.h
```c
/** @file
 *  @brief HoG Service sample
 */

/*
 * Copyright (c) 2016 Intel Corporation
 *
 * SPDX-License-Identifier: Apache-2.0
 */

#ifdef __cplusplus
extern "C"
{
#endif

    void hog_init(void);

    void hog_button_loop(int8_t global_report[8]);

#ifdef __cplusplus
}
#endif
```
